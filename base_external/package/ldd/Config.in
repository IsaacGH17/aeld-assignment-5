## base_external/package/ldd/Config.in
```kconfig
config BR2_PACKAGE_LDD
	bool "ldd kernel modules"
	help
	  Includes the ldd3 kernel modules scull and misc-modules
	  from the assignment7 repo in the root filesystem.
```
